#include <dt-bindings/zmk/behaviors.h>

/ {
    behaviors {
        mt: mod_tap {
            compatible = "zmk,behavior-hold-tap";
            flavor = "tap-preferred";
            tapping-term-ms = <200>;
        };
    };
};
